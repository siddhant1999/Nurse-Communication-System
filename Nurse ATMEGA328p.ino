#include <SPI.h>
#include <Adafruit_GFX.h>
#include <TFT_ST7735.h>
#include <avr/pgmspace.h>

#include <SoftwareSerial.h>

const byte HC12RxdPin = 4;                  // Recieve Pin on HC12
const byte HC12TxdPin = 5;                  // Transmit Pin on HC12

SoftwareSerial HC12(HC12TxdPin, HC12RxdPin); // Create Software Serial Port

// Color definitions
#define BLACK   0x0000
#define BLUE    0x001F
#define RED     0xF800
#define GREEN   0x07E0
#define CYAN    0x07FF
#define MAGENTA 0xF81F
#define YELLOW  0xFFE0  
#define WHITE   0xFFFF

/*
Teensy3.x and Arduino's
You are using 4 wire SPI here, so:
 MOSI:  11//Teensy3.x/Arduino UNO (for MEGA/DUE refere to arduino site)
 MISO:  12//Teensy3.x/Arduino UNO (for MEGA/DUE refere to arduino site)
 SCK:   13//Teensy3.x/Arduino UNO (for MEGA/DUE refere to arduino site)
 the rest of pin below:
 */
#define __CS1 10
#define __DC 9
/*
Teensy 3.x can use: 2,6,9,10,15,20,21,22,23
Arduino's 8 bit: any
DUE: check arduino site
If you do not use reset, tie it to +3V3
*/


TFT_ST7735 display = TFT_ST7735(__CS1,8, __DC);


const uint8_t shower[200] PROGMEM= { // 'bathroom_transparent64x64', 64x64px
  // 'bathroom_white40x40', 40x40px
 // 'bathroom_white40x40', 40x40px
0x00, 0x00, 0x00, 0x00, 0x00, 0x00, 0x00, 0x00, 0x00, 0x00, 0x00, 0x00, 0x00, 0x00, 0x00, 0x00, 
0x00, 0x00, 0x00, 0x00, 0x00, 0x00, 0x00, 0x00, 0x00, 0x01, 0xfc, 0x00, 0x00, 0x00, 0x03, 0xff, 
0x00, 0x00, 0x00, 0x07, 0xff, 0xf0, 0x00, 0x00, 0x0f, 0x1f, 0xfe, 0x00, 0x00, 0x1e, 0x1f, 0xfe, 
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0x00, 0x00, 0x00, 0x00, 0x00, 0x00, 0x00, 0x00
};

const uint8_t cross[200] PROGMEM= {
 // 'emergency_white32x32', 32x32px
 // 'emergency_white40x40', 40x40px
0x00, 0x00, 0x3c, 0x00, 0x00, 0x00, 0x03, 0xff, 0xc0, 0x00, 0x00, 0x1f, 0xff, 0xf8, 0x00, 0x00, 
0x3f, 0xff, 0xfc, 0x00, 0x00, 0xff, 0xff, 0xff, 0x00, 0x01, 0xff, 0xff, 0xff, 0x80, 0x03, 0xff, 
0xff, 0xff, 0xc0, 0x07, 0xff, 0x81, 0xff, 0xe0, 0x0f, 0xff, 0x00, 0xff, 0xf0, 0x1f, 0xff, 0x00, 
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0xff, 0xc0, 0x00, 0x00, 0x00, 0x18, 0x00, 0x00
};

const uint8_t ass[200] PROGMEM= {
 // 'assistance_white40x40', 40x40px
0x00, 0x00, 0x00, 0x00, 0x00, 0x00, 0x00, 0x00, 0x00, 0x00, 0x00, 0x00, 0x00, 0x00, 0x00, 0x00, 
0x00, 0x00, 0x00, 0x00, 0x00, 0x00, 0x30, 0x00, 0x00, 0x00, 0x00, 0x30, 0x00, 0x00, 0x00, 0x01, 
0xb0, 0x00, 0x00, 0x00, 0x01, 0xb6, 0x00, 0x00, 0x00, 0x01, 0xb6, 0x00, 0x00, 0x00, 0x01, 0xb6, 
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0x00, 0x00, 0x00, 0x00, 0x00, 0x00, 0x00, 0x00

};

int top = -1;
int bot = -1;
int isGreen = 0;
char pre = 'p';
int itt= 0;
int counter= -1;
int list[100]= {
-1, -1, -1, -1, -1, -1, -1, -1, -1, -1, -1, -1,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 -1, 

  };
void setup(void) {
  display.begin();
  display.setRotation(2);
  pinMode(2, INPUT);
  pinMode(3, INPUT);
  pinMode(6, OUTPUT);
  // initialize the pushbutton pin as an input:
  Serial.begin(9600);                       // Open serial port to computer
  HC12.begin(9600);                         // Open serial port to HC12
  uint16_t time = millis();
  time = millis() - time;
  
  //display.drawBitmap(85, 15, shower, 40, 40, BLUE);
  initi();
  
  //display.drawChar(10, 10, '3', BLACK, WHITE, 6);
//display.drawBitmap(32, 32, cross, 64, 64, RED);

}
char prev = '9';
int checki = 0;


int remov = 0;
void loop() {
  remov = 0;
  if(counter==2000){
    remov = 1;
    counter = -1;
  }
  String content = "";
  char charac;
  check(checki);
  
  if (HC12.available()) {
    charac = HC12.read();
    content.concat(charac);
    if(charac != prev){
      //Serial.print(content);
      //display.print(content);
      
      if(charac == '0' || charac == '3' || charac == '4'){
        list[itt]=charac-'0';
      
        itt++;
        check(checki);
        digitalWrite(6, HIGH);
        delay(500);
        digitalWrite(6, LOW);
        prev = charac;
      }
    }

  }
  if(isGreen){
    counter++;
    Serial.println(counter);
  }
  int acc = digitalRead(3);
  int rej = digitalRead(2);
  if(acc == HIGH && rej == HIGH){
    int abc = top;
    int cba = bot;
    top = -5;
    bot = -5;
    digitalWrite(6, HIGH);
    delay(300);
    digitalWrite(6, LOW);
    initi();
    delay(5000);
    top = abc;
    bot= cba;
  }
  if(acc == HIGH){
    Serial.print("Accept");
    isGreen = 1;
    digitalWrite(6, HIGH);
        delay(100);
        digitalWrite(6, LOW);
    initi();
    //but then also set timer
  }
  if(rej== HIGH || remov){
    Serial.print("Reject");
    top=bot;
    bot= -1;
    isGreen=0;
    digitalWrite(6, HIGH);
        delay(100);
        digitalWrite(6, LOW);
    //initi();
    check(checki);
    initi();
    delay(500);
  }
  char character;
  if (Serial.available()) {
    character = Serial.read();
    Serial.write(character);
    HC12.write(character);
  }

}
void check(int y){
  if(list[y] == -1){
    return;
  }
  if(top == -1){
    
    top = list[y];
    checki++;
    initi();
  }
  else if(bot == -1){
    
    bot = list[y];
    checki++;
    initi();
  }
}


void initi(){
  if(isGreen == 0){
    display.fillRect(0, 0, 128, 64, WHITE);
  }
  if(isGreen == 1){
    display.fillRect(0, 0, 128, 64, YELLOW );
  }
  display.fillRect(0, 65, 128, 63, WHITE);
  display.setTextScale(1);
  display.setTextColor(BLACK);
  display.setCursor(2,2);
  display.print("Room");
  display.setCursor(50,2);
  display.print(__DATE__[0]);
  display.print(__DATE__[1]);
  display.print(__DATE__[2]);
  display.print(__DATE__[3]);
  display.print(__DATE__[4]);
  display.print(__DATE__[5]);
  display.setCursor(112,2);
  display.print("Call");
  //now actually use the array

  //first
  if(top == -1 & bot == -1){
    display.setCursor(13,20);
    display.setTextScale(4);
    display.print("Ready");
    display.setCursor(15,84);
    display.print("To Go");
    return;
  }
  if(top == -5 & bot == -5){
    display.setCursor(21,30);
    display.setTextScale(3);
    display.print("Nurses");
    display.setCursor(15,94);
    display.print("Notified");
    return;
  }
  if(top == 0){//change to 0
    //ass
    display.setCursor(7,23);
    display.setTextScale(4);
    display.print("341");
    display.drawBitmap(85, 20, ass, 40, 40, GREEN);
  
  }

  if(top == 3){
    display.setCursor(7,26);
    display.setTextScale(4);
    display.print("892");
    display.drawBitmap(85, 20, shower, 40, 40, BLUE);
  }
  if(top == 4){
    display.setCursor(7,26);
    display.setTextScale(4);
    display.print("373");
    display.drawBitmap(85, 20, cross, 40, 40, RED);
  }



  if(bot == 0){
    display.setCursor(7,87);
    display.print("341");
    display.drawBitmap(85, 81, ass, 40, 40, GREEN);
  }
  if(bot == 3){
    display.setCursor(7,87);
    display.print("892");
    display.drawBitmap(85, 81, shower, 40, 40, BLUE);
  }
  if(bot == 4){
    display.setCursor(7,87);
    display.print("373");
    display.drawBitmap(85, 81, cross, 40, 40, RED);
  }
}

